## homelab-esp32-devices/devices/freezer-temp-sensor/main/Kconfig.projbuild
```kconfig
menu "Freezer Temp Sensor"

    config USE_FAKE_TEMP_SENSOR
        bool "Use fake sine-wave temperature sensor"
        default n
        help
            Replace the real DS18B20 sensor with a fake sine-wave generator.
            Useful for testing firmware on boards without a sensor attached.

    config DEVICE_PRODUCT_NAME
        string "Matter product name"
        default "Freezer Temp Sensor"
        help
            The product name reported via the Matter Basic Information cluster.
            Shown in Home Assistant after commissioning.

    config DEVICE_VENDOR_NAME
        string "Matter vendor name"
        default "Homelab"
        help
            The vendor name reported via the Matter Basic Information cluster.

endmenu
```

## homelab-esp32-devices/devices/freezer-temp-sensor/sdkconfig.defaults
```kconfig
# Target
CONFIG_IDF_TARGET="esp32c6"
CONFIG_ESP_CONSOLE_USB_SERIAL_JTAG=y
CONFIG_ESPTOOLPY_FLASHSIZE_4MB=y
CONFIG_PARTITION_TABLE_CUSTOM=y
CONFIG_PARTITION_TABLE_CUSTOM_FILENAME="partitions.csv"

# Stack sizes (Matter needs more)
CONFIG_ESP_MAIN_TASK_STACK_SIZE=8192
CONFIG_CHIP_TASK_STACK_SIZE=8192

# Thread (Matter manages OT, but we enable the underlying support)
CONFIG_OPENTHREAD_ENABLED=y
CONFIG_IEEE802154_ENABLED=y
CONFIG_OPENTHREAD_SRP_CLIENT=y
CONFIG_OPENTHREAD_DNS_CLIENT=y
CONFIG_OPENTHREAD_LOG_LEVEL_DYNAMIC=n
CONFIG_OPENTHREAD_LOG_LEVEL_NOTE=y
CONFIG_OPENTHREAD_CLI=n
CONFIG_OPENTHREAD_CONSOLE_ENABLE=n
CONFIG_OPENTHREAD_BORDER_ROUTER=n

# WiFi disabled (Thread-only device)
CONFIG_ESP_WIFI_ENABLED=n
CONFIG_ENABLE_WIFI_STATION=n

# BLE enabled for commissioning only; disabled after first successful commission
CONFIG_BT_ENABLED=y
CONFIG_BT_NIMBLE_ENABLED=y
CONFIG_USE_BLE_ONLY_FOR_COMMISSIONING=y

# Software coexistence between BLE and 802.15.4 (Thread) — required on ESP32-C6
# when both radios are active simultaneously (e.g., during commissioning)
CONFIG_ESP_COEX_SW_COEXIST_ENABLE=y

# Matter
CONFIG_ENABLE_EXTENDED_DISCOVERY=y
# Use platform DNS-SD (SRP via border router) instead of minimal mDNS.
# With USE_MINIMAL_MDNS=y the device broadcasts mDNS directly on the Thread
# interface; HA on Ethernet never sees it. With USE_MINIMAL_MDNS=n, the SRP
# client registers with the border router, which proxies the service to HA.
CONFIG_USE_MINIMAL_MDNS=n

# LWIP for Thread/Matter
CONFIG_LWIP_IPV6_NUM_ADDRESSES=8
CONFIG_LWIP_MULTICAST_PING=y
CONFIG_LWIP_IPV6_AUTOCONFIG=y
# Route hooks needed for ENABLE_ROUTE_HOOK (RIO support) and proper IPv6 gw
CONFIG_LWIP_HOOK_IP6_ROUTE_DEFAULT=y
CONFIG_LWIP_HOOK_ND6_GET_GW_DEFAULT=y

# BLE — disable reattempt (per official examples)
CONFIG_BT_NIMBLE_ENABLE_CONN_REATTEMPT=n

# mbedTLS (Matter needs HKDF)
CONFIG_MBEDTLS_HKDF_C=y

# NVS
CONFIG_NVS_FLASH=y

# Fake sensor for debug boards without DS18B20
CONFIG_USE_FAKE_TEMP_SENSOR=y
```

## homelab-esp32-devices/devices/garage-opener/sdkconfig.defaults
```kconfig
CONFIG_IDF_TARGET="esp32s2"
CONFIG_ESP_CONSOLE_USB_CDC=y
CONFIG_ESP_MAIN_TASK_STACK_SIZE=8192
```
